## fs/nomount/Kconfig
```kconfig
# Kconfig for NoMount

config NOMOUNT
	bool "NoMount Path Redirection Subsystem"
	depends on KEYS && SRCU
	default y
	help
	  NoMount allows path redirection and virtual file injection
	  without mounting filesystems. Useful for systemless modifications.
```
